## buildroot-external/package/aw882xx/Config.in
```kconfig
comment "aw882xx needs a Linux kernel to be built"
	depends on !BR2_LINUX_KERNEL

config BR2_PACKAGE_AW882XX
	bool "aw882xx"
	depends on BR2_LINUX_KERNEL
	help
	  aw882xx sound driver

	  git@github.com:m5stack/m5stack-linux-dtoverlays.git
```
